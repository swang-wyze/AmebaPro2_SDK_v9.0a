## component/bluetooth/zephyr_stack/stack/dependence/Kconfig
```kconfig
menu "Dependence"

menu "Board setup"
choice 
	prompt "CPU architecture"
	default ARM
	help
	  to be done

config ARM
	bool "Arm"
	help
	  to be done

endchoice

choice 
	prompt "Platform select"
	default PLATFORM_8710C
	help
	  to be done

config PLATFORM_8710C
	bool "8710C"
	help
	  to be done

endchoice

config SYS_CLOCK_HW_CYCLES_PER_SEC
	int "System clock frequence"
	default 72000000
	help
	  to be done

config HEAP_MEM_POOL_SIZE
	int "Mempool size of heap"
	default 0
	help
	  to be done

config CLOCK_CONTROL
	bool "Enable clock control"
	default y
	help
	  to be done

config USE_ZEPHYR_BT_STACK
	bool "Use zephyr bt stack"
	default y
	help
	  to be done

config SETTINGS
	bool "Enable settings"
	default n
	help
	  to be done

endmenu #Board setup

menu "OS setup"

choice 
	prompt "RTOS select"
	default KERNEL_RTOS_FREERTOS
	help
	  to be done

config KERNEL_RTOS_FREERTOS
	bool "FreeRTOS"
	help
	  to be done

endchoice

config USE_STATIC_MEM
	bool "Use static memory"
	default y
	help
	  to be done

config PRINTK
	bool "Printk support"
	default y
	help
	  to be done

config ASSERT
	bool "Assert support"
	default y
	help
	  to be done
endmenu # OS setup

rsource "kernel/Kconfig"

menu "BT debug and log system"

config BT_LOG_LEVEL
	int "BT log level"
	default 5
	help
	  to be done

endmenu # BT debug and log system

rsource "tinycrypt/Kconfig"
rsource "hci/Kconfig"
rsource "shell/Kconfig"
rsource "settings/Kconfig"

endmenu # dependence
```

## component/bluetooth/zephyr_stack/stack/dependence/hci/btsnoop/Kconfig
```kconfig
comment "Bluetooth HCI BTSNOOP Setup Options"

config BT_HCI_BTSNOOP
	bool  "Btsnoop protocol over UART"
	default y
	depends on BT_HCI
	

config BT_HCI_BTSNOOP_TASK
	bool "Btsnoop TX use a thread"
	depends on BT_HCI_BTSNOOP
	help
	  This option will create a task to send btsnoop packets through uart.
```

## component/bluetooth/zephyr_stack/stack/dependence/kernel/Kconfig
```kconfig
menu "Kernel related setup"

menu "Net Buf"
config NET_BUF
	bool "Network buffer support"
	help
	  This option enables support for generic network protocol
	  buffers.

if NET_BUF

config NET_BUF_USER_DATA_SIZE
    int "Net buf user data's size"
    default 4
    help
      to be done

config NET_BUF_LOG
	bool "Network buffer logging"
	select LOG
	help
	  Enable logs and checks for the generic network buffers.

endif

if NET_BUF_LOG

config NET_BUF_WARN_ALLOC_INTERVAL
    int "Net buf warn alloc interval"
    default 0
    help
      to be done
    
config NET_BUF_LOG_LEVEL
    int "Net buf log level"
    default 3
    help
      to be done

endif #NET_BUF_LOG
endmenu

endmenu
```

## component/bluetooth/zephyr_stack/stack/dependence/settings/Kconfig
```kconfig
menu "BT settings setup"
if SETTINGS

config BT_SETTINGS
    bool "BT settings support"
    default y if SETTINGS
    help
      to be done

if BT_SETTINGS

config BT_SETTINGS_CCC_LAZY_LOADING
    bool "BT settings ccc lazy loading support"
    default y 
    help
      to be done

config BT_SETTINGS_USE_PRINTK
    bool "BT setting use printk"
    default y
    help
      to be done

endif # BT_SETTINGS

config SETTINGS_LOG_LEVEL_INF
    bool "Settings log level inf"
    default y
    help
      to be done

config SETTINGS_LOG_LEVEL
    int "Settings log level"
    default 3
    help
      to be done

config SETTINGS_DYNAMIC_HANDLERS
    bool "Settings dynamic handler support"
    default y
    help
      to be done
      
endif # SETTINGS
endmenu
```

## component/bluetooth/zephyr_stack/stack/dependence/shell/Kconfig
```kconfig
# Shell entry and Shell priv cmds

menu "Shell entry & private cmds"

config BT_SHELL_PRIV
  bool "Shell entry and private commands Support"
  default y
  help
    This option enables Shell entry and private commands.

endmenu # Shell entry & private cmds
```
